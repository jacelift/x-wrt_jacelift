// SPDX-License-Identifier: GPL-2.0-or-later OR MIT
/dts-v1/;

#include "qca9558_tplink_tl-wdr4900-v2.dts"

/ {
	compatible = "tplink,tl-wdr4900-v2-16m", "qca,qca9558";
	model = "TP-Link TL-WDR4900 v2 16M";
};
